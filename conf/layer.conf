## conf/layer.conf
```bitbake
BBPATH .= ":${LAYERDIR}"
BBFILES += "${LAYERDIR}/recipes*/*/*.bb ${LAYERDIR}/recipes*/*/*.bbappend"
BBFILE_COLLECTIONS += "n950-layer"
BBFILE_PATTERN_dory-hybris-layer := "^${LAYERDIR}/"
BBFILE_PRIORITY_dory-hybris-layer = "7"
```

## conf/machine/n950.conf
```bitbake
#@TYPE: Machine
#@NAME: N950
#@DESCRIPTION: Machine configuration for the Nokia N950

require conf/machine/include/tune-cortexa8.inc

MACHINE_FEATURES = "apm alsa bluetooth usbgadget usbhost vfat ext2 wifi nfc 3g phone"

KERNEL_IMAGETYPE = "zImage"
IMAGE_FSTYPES += "ext4"

IMAGE_INSTALL += ""
```
